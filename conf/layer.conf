## conf/layer.conf
```bitbake
# We have a conf and classes directory, add to BBPATH
BBPATH .= ":${LAYERDIR}"

# We have recipes-* directories, add to BBFILES
BBFILES += "${LAYERDIR}/recipes-*/*/*.bb \
	${LAYERDIR}/recipes-*/*/*.bbappend"

BBFILE_COLLECTIONS += "snappy-tools"
BBFILE_PATTERN_snappy-tools = "^${LAYERDIR}/"
BBFILE_PRIORITY_snappy-tools = "6"

LAYERDEPENDS_snappy-tools = "core"
```
